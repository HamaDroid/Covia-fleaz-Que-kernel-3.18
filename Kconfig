## Kconfig
```kconfig
#
# For a description of the syntax of this configuration file,
# see Documentation/kbuild/kconfig-language.txt.
#
mainmenu "Linux/$ARCH $KERNELVERSION Kernel Configuration"

config SRCARCH
	string
	option env="SRCARCH"

source "arch/$SRCARCH/Kconfig"

config PROJECT_L7
	bool "mibound project L7"
	default n

config PROJECT_M7
	bool "mibound project M7"
	default n

config PROJECT_T62
	bool "mibound project T62"
	default n

config HIGHCURRENT_1500MA
	bool "fan5405 & ET9520 support 1500mA charging current"
	default n

config ESD_OLD_STYLE
	bool "turn on esd by lcm code not by dts"
	default n
config CUSTOM_M7
	bool "mibound M7"
	default n
```

## drivers/misc/mediatek/alsps/ap3xx6c/Kconfig
```kconfig
config MTK_AP3XX6C
	bool "ap3xx6c for MediaTek package"
	default n
	help
	It support different type sensor
	in this platform. If this option
	is set, it will support ambient
	and light sensor AP3XX6C.
```

## drivers/misc/mediatek/flashlight/Kconfig
```kconfig
config MTK_FLASHLIGHT
  bool CONFIG_MTK_FLASHLIGHT
  default n
  help
    CONFIG_MTK_FLASHLIGHT

config MTK_FLASHLIGHT_DRIVER_CHIP
  bool CONFIG_MTK_FLASHLIGHT_DRIVER_CHIP
  string "MTK_FLASHLIGHT_DRIVER_CHIP"
  default n

config CUSTOM_KERNEL_FLASHLIGHT
        string "CUSTOM_KERNEL_FLASHLIGHT"
        help
          Kernel space cameara flashlight driver. You can use this driver
          choose cameara flashlight type.
```
